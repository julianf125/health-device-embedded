## CMakeLists.txt
```
# SPDX-License-Identifier: Apache-2.0

cmake_minimum_required(VERSION 3.20.0)

find_package(Zephyr REQUIRED HINTS $ENV{ZEPHYR_BASE})
project(peripheral_hr)

target_include_directories(app PRIVATE ${CMAKE_CURRENT_SOURCE_DIR}/src)

FILE(GLOB app_sources src/*.c)
target_sources(app PRIVATE
  ${app_sources}
  ${CMAKE_CURRENT_SOURCE_DIR}/src/r_enc.c
  ${CMAKE_CURRENT_SOURCE_DIR}/src/bluetooth.c
  ${CMAKE_CURRENT_SOURCE_DIR}/src/imu.c
  ${CMAKE_CURRENT_SOURCE_DIR}/src/rc_filter.c
  ${CMAKE_CURRENT_SOURCE_DIR}/src/bme.c
  ${CMAKE_CURRENT_SOURCE_DIR}/src/temp.c
  ${CMAKE_CURRENT_SOURCE_DIR}/src/hr.c
  )

zephyr_library_include_directories(${ZEPHYR_BASE}/samples/bluetooth)
```

## prj.conf
```kconfig
CONFIG_GPIO=y
CONFIG_SPI=y
CONFIG_BT=y
CONFIG_LOG=y
CONFIG_BT_SMP=y
CONFIG_BT_PERIPHERAL=y
CONFIG_BT_DIS=y
CONFIG_BT_DIS_PNP=n
CONFIG_BT_BAS=y
CONFIG_BT_HRS=y
CONFIG_BT_DEVICE_NAME="Zephyr Heartrate Sensor"
CONFIG_BT_DEVICE_APPEARANCE=833
CONFIG_GPIO=y
CONFIG_GPIO_NRFX_INTERRUPT=y
CONFIG_I2C=y
CONFIG_BT=y
CONFIG_SPI=y
```

## prj_minimal.conf
```kconfig
CONFIG_BT=y
CONFIG_BT_SMP=y
CONFIG_BT_PERIPHERAL=y
CONFIG_BT_DIS=y
CONFIG_BT_DIS_PNP=n
CONFIG_BT_BAS=y
CONFIG_BT_HRS=y
CONFIG_BT_DEVICE_NAME="Zephyr Heartrate Sensor"
CONFIG_BT_DEVICE_APPEARANCE=833

# Drivers and peripherals
CONFIG_I2C=y
CONFIG_WATCHDOG=n
CONFIG_PINCTRL=n
CONFIG_SPI=n
CONFIG_GPIO=n
CONFIG_SERIAL=n

# Power management
CONFIG_PM=n

# Interrupts
CONFIG_DYNAMIC_INTERRUPTS=n
CONFIG_IRQ_OFFLOAD=n

# Memory protection
CONFIG_THREAD_STACK_INFO=n
CONFIG_THREAD_CUSTOM_DATA=n
CONFIG_FPU=n

# Boot
CONFIG_BOOT_BANNER=n
CONFIG_BOOT_DELAY=0

# Console
CONFIG_CONSOLE=n
CONFIG_UART_CONSOLE=n
CONFIG_STDOUT_CONSOLE=n
CONFIG_PRINTK=n
CONFIG_EARLY_CONSOLE=n

# Build
CONFIG_SIZE_OPTIMIZATIONS=y

# ARM
CONFIG_ARM_MPU=n

# In order to correctly tune the stack sizes for the threads the following
# Configurations can enabled to print the current use:
# CONFIG_THREAD_NAME=y
# CONFIG_THREAD_ANALYZER=y
# CONFIG_THREAD_ANALYZER_AUTO=y
# CONFIG_THREAD_ANALYZER_RUN_UNLOCKED=y
# CONFIG_THREAD_ANALYZER_USE_PRINTK=y
# CONFIG_THREAD_ANALYZER_AUTO_INTERVAL=20
# CONFIG_CONSOLE=y
# CONFIG_UART_CONSOLE=y
# CONFIG_SERIAL=y
# CONFIG_PRINTK=y

# Example output of thread analyzer
# BT RX               : STACK: unused 576 usage 448 / 1024 (43 %); CPU: 0 %
# BT RX pri           : STACK: unused 260 usage 188 / 448 (41 %); CPU: 0 %
# BT ECC              : STACK: unused 256 usage 888 / 1144 (77 %); CPU: 1 %
# BT TX               : STACK: unused 296 usage 344 / 640 (53 %); CPU: 0 %
# thread_analyzer     : STACK: unused 128 usage 384 / 512 (75 %); CPU: 1 %
# sysworkq            : STACK: unused 856 usage 168 / 1024 (16 %); CPU: 0 %
# logging             : STACK: unused 232 usage 536 / 768 (69 %); CPU: 0 %
# idle 00             : STACK: unused 208 usage 48 / 256 (18 %); CPU: 97 %
# main                : STACK: unused 576 usage 448 / 1024 (43 %); CPU: 0 %
CONFIG_BT_RX_STACK_SIZE=1024
CONFIG_BT_CTLR_RX_PRIO_STACK_SIZE=448
CONFIG_BT_HCI_TX_STACK_SIZE_WITH_PROMPT=y
CONFIG_BT_HCI_TX_STACK_SIZE=640
CONFIG_SYSTEM_WORKQUEUE_STACK_SIZE=512
CONFIG_IDLE_STACK_SIZE=128
CONFIG_MAIN_STACK_SIZE=640
CONFIG_ISR_STACK_SIZE=1024

# Disable features not needed
CONFIG_TIMESLICING=n
CONFIG_COMMON_LIBC_MALLOC=n
CONFIG_LOG=n
CONFIG_ASSERT=n

# Disable Bluetooth features not needed
# CONFIG_BT_DEBUG_NONE=y
CONFIG_BT_ASSERT=n
CONFIG_BT_DATA_LEN_UPDATE=n
CONFIG_BT_PHY_UPDATE=n
CONFIG_BT_GATT_CACHING=n
CONFIG_BT_GATT_SERVICE_CHANGED=n
CONFIG_BT_GAP_PERIPHERAL_PREF_PARAMS=n
CONFIG_BT_SETTINGS_CCC_LAZY_LOADING=y
CONFIG_BT_HCI_VS_EXT=n

# Disable Bluetooth controller features not needed
CONFIG_BT_CTLR_PRIVACY=n
CONFIG_BT_CTLR_PHY_2M=n

# Reduce Bluetooth buffers
CONFIG_BT_BUF_EVT_DISCARDABLE_COUNT=1
CONFIG_BT_BUF_EVT_DISCARDABLE_SIZE=45
CONFIG_BT_BUF_ACL_RX_COUNT=2
CONFIG_BT_BUF_EVT_RX_COUNT=2

CONFIG_BT_CONN_TX_MAX=2
CONFIG_BT_L2CAP_TX_BUF_COUNT=2
CONFIG_BT_CTLR_RX_BUFFERS=1
CONFIG_BT_BUF_ACL_TX_COUNT=3
CONFIG_BT_BUF_ACL_TX_SIZE=27
```

## src/main.c
```c
/* main.c - Application main entry point */

#include <zephyr/types.h>
#include <stddef.h>
#include <string.h>
#include <errno.h>
#include <zephyr/sys/printk.h>
#include <zephyr/sys/byteorder.h>
#include <zephyr/kernel.h>

#include <zephyr/bluetooth/bluetooth.h>
#include <zephyr/bluetooth/hci.h>
#include <zephyr/bluetooth/conn.h>
#include <zephyr/bluetooth/uuid.h>
#include <zephyr/bluetooth/gatt.h>
#include <zephyr/bluetooth/services/bas.h>
#include <zephyr/bluetooth/services/hrs.h>

#include "../inc/display.h"
#include "../inc/spi.h"
#include "../inc/r_enc.h"
#include "../inc/bluetooth.h" //TODO: TEST THAT BLUETOOTH WORKS ON DONGLE W/ MOVING BT CODE TO SEP. FILE
#include "../inc/bme.h"
#include "../inc/temp.h"
#include "../inc/hr.h"

const struct device* gpio0_dev = DEVICE_DT_GET(DT_NODELABEL(gpio0));
const struct device* gpio1_dev = DEVICE_DT_GET(DT_NODELABEL(gpio1));
const struct device* i2c0_dev = DEVICE_DT_GET(DT_NODELABEL(i2c0));
const struct device *spi1_dev = DEVICE_DT_GET(DT_NODELABEL(spi1));

int main(void)
{
	uint16_t color = 0xFFFF; // Black color

	main_display_init(spi1_dev, gpio0_dev, color);

	int err;
	err = bt_enable(NULL);
	if (err) {
		printk("Bluetooth init failed (err %d)\n", err);
		return 0;
	}

	bt_ready();
	bt_conn_auth_cb_register(&auth_cb_display);
	init_enc();
	BME688_Init();
	init_hr();

	/* Implement notification. At the moment there is no suitable way
	 * of starting delayed work so we do it here
	 */
	while (1) {
		k_sleep(K_SECONDS(1));
		check_enc_btn();

		/* Heartrate measurements simulation */
		hrs_notify();

		/* Battery level simulation */
		bas_notify();

		//weather sensor
		BME688_Take_Measurement();
		int humidity = (int)BME688_Get_Humidity();
		// char gas_str[30];
		// sprintf(gas_str, "%f", gas);
		printk("humidity: %d\n", humidity);

		/* Update the display */
		// color = main_display_update_test(spi1_dev, gpio0_dev, color);
		
		float final_temp = get_body_temp();
		int temp_int = (int)final_temp;
		int temp_frac = (int)((final_temp-temp_int)*100);
		printf("Body Temperature: %d.%d F\n", temp_int, temp_frac);

		float heart_rate = read_hr();
		float SpO2 = read_blood_ox();

		int HR_whole = (int)heart_rate;
		int HR_frac = (int)((heart_rate - HR_whole)*10);

		int SpO2_whole = (int)SpO2;
		int SpO2_frac = (int)((SpO2 - SpO2_whole)*10);
		
		printf("Heart rate: %d.%d BPM\n", HR_whole, HR_frac);
		printf("Blood oxygen saturation: %d.%d%%\n\n", SpO2_whole, SpO2_frac);
	}
	return 0;
}
```

## inc/bluetooth.h
```c
#ifndef BT
#define BT

#include <zephyr/bluetooth/bluetooth.h>
#include <zephyr/bluetooth/hci.h>
#include <zephyr/bluetooth/conn.h>
#include <zephyr/bluetooth/uuid.h>
#include <zephyr/bluetooth/gatt.h>
#include <zephyr/bluetooth/services/bas.h>
#include <zephyr/bluetooth/services/hrs.h>

extern struct bt_conn_auth_cb auth_cb_display;

void connected(struct bt_conn *conn, uint8_t err);
void disconnected(struct bt_conn *conn, uint8_t reason);
void bt_ready(void);
void auth_cancel(struct bt_conn *conn);
void bas_notify(void);
void hrs_notify(void);

#endif
```

## inc/imu.h
```c
/*
SPI1 pins:
VIN:  vdd
INT1: P102
SCL: PO31
SDA: PO30
CSAG: P107
SDOAG: P108

SPI3 pins:
VIN:  vdd
INT1 (white): P102
CSAG (brown): P107
SCL/SCK (blue): P115
SDA/MOSI (gray): P113
SDOAG/MISO (orange): P114
*/

#include <zephyr/kernel.h>
#include <zephyr/drivers/gpio.h>
#include <zephyr/drivers/spi.h>
#include <stdlib.h>
#include <stdio.h>
#include <string.h>
#include <zephyr/sys/printk.h>
#include "rc_filter.h"

//relevant registers masks used for IMU
#define CHIPID_REG_READ 0b10001111
#define CTRL_REG1_G_WRITE 0b00010000
#define CTRL_REG1_G_READ 0b10010000
#define ACCEL_X_UPPER 0b10101001
#define ACCEL_X_LOWER 0b10101000
#define ACCEL_Y_UPPER 0b10101011
#define ACCEL_Y_LOWER 0b10101010
#define ACCEL_Z_UPPER 0b10101101
#define ACCEL_Z_LOWER 0b10101100
#define G_X_UPPER 0b10011001
#define G_X_LOWER 0b10011000
#define G_Y_UPPER 0b10011011
#define G_Y_LOWER 0b10011010
#define G_Z_UPPER 0b10011101
#define G_Z_LOWER 0b10011100
#define CTRL_REG1_G_952_ODR 0b11000000
#define INT1_CTRL_READ 0b10001100
#define INT1_CTRL_WRITE 0b00001100
#define INT_IG_XL 0b01000000
#define INT_GEN_CFG_XL_READ 0b10000110
#define INT_GEN_CFG_XL_WRITE 0b00000110
#define XHIE_XL 0b00000010
#define XLIE_XL 0b00000001
#define INT_GEN_THS_X_XL_WRITE 0b00000111
#define INT_GEN_THS_X_XL_READ 0b10000111
#define STATUS_REG_READ 0b10010111
#define INT_GEN_SRC_XL_READ 0b10100110
#define INT_GEN_SRC_XL_WRITE 0b00100110
#define STATUS_REG_READ 0b10010111
#define STATUS_REG_WRITE 0b00010111
#define CTRL_REG6_XL_READ 0b10100000
#define CTRL_REG6_XL_WRITE 0b00100000
#define CTRL_REG6_XL_FS_XL_8G 0b00011000
#define CTRL_REG6_XL_ODR_XL_952 0b11000000
#define FS_XL_4G 0b00010000

#define PIN_1_02 2
#define SPI3_NODE DT_NODELABEL (spi3)
#define MY_GPI01 DT_NODELABEL (gpio1)
#define GPIO_1_CS 7

#define NUM_AXES 6
#define XL_X_IND 0
#define XL_Y_IND 1
#define XL_Z_IND 2
#define G_X_IND 3
#define G_Y_IND 4
#define G_Z_IND 5

extern const struct device *spi3_dev;
extern struct spi_config spi3_cfg;
extern const struct device *gpio1_dev;
// extern struct gpio_callback gpio_cb;

//order of indices: xl_x, xl_y, xl_z, g_x, g_y, g_z
extern RCFilter lp_filters[NUM_AXES]; 
extern float cutoff_freqs[NUM_AXES];

extern volatile float IMU_readings[NUM_AXES]; //sensor readings in g's and dps
extern volatile int interrupt_called;
extern volatile int max_x;

void spi_read_reg(uint8_t reg, uint8_t values[], uint8_t size);
void spi_write_reg(uint8_t reg, uint8_t data, uint8_t size);
void init_IMU();
void init_IMU_interrupts();
void IMU_interrupt_cb(const struct device *dev, struct gpio_callback *cb, uint32_t pins);
void init_IMU_cs();
void poll_IMU();
void init_RCFilters();
```

## src/bluetooth.c
```c
#include "../inc/bluetooth.h"

static const struct bt_data ad[] = {
	BT_DATA_BYTES(BT_DATA_FLAGS, (BT_LE_AD_GENERAL | BT_LE_AD_NO_BREDR)),
	BT_DATA_BYTES(BT_DATA_UUID16_ALL,
		      BT_UUID_16_ENCODE(BT_UUID_HRS_VAL),
		      BT_UUID_16_ENCODE(BT_UUID_BAS_VAL),
		      BT_UUID_16_ENCODE(BT_UUID_DIS_VAL))
};

struct bt_conn_auth_cb auth_cb_display = {
	.cancel = auth_cancel,
};

void connected(struct bt_conn *conn, uint8_t err)
{
	if (err) {
		printk("Connection failed (err 0x%02x)\n", err);
	} else {
		printk("Connected\n");
	}
}

void disconnected(struct bt_conn *conn, uint8_t reason)
{
	printk("Disconnected (reason 0x%02x)\n", reason);
}

BT_CONN_CB_DEFINE(conn_callbacks) = {
	.connected = connected,
	.disconnected = disconnected,
};

void bt_ready(void)
{
	int err;

	printk("Bluetooth initialized\n");

	err = bt_le_adv_start(BT_LE_ADV_CONN_NAME, ad, ARRAY_SIZE(ad), NULL, 0);
	if (err) {
		printk("Advertising failed to start (err %d)\n", err);
		return;
	}

	printk("Advertising successfully started\n");
}

void auth_cancel(struct bt_conn *conn)
{
	char addr[BT_ADDR_LE_STR_LEN];

	bt_addr_le_to_str(bt_conn_get_dst(conn), addr, sizeof(addr));

	printk("Pairing cancelled: %s\n", addr);
}

void bas_notify(void)
{
	uint8_t battery_level = bt_bas_get_battery_level();

	battery_level--;

	if (!battery_level) {
		battery_level = 100U;
	}

	bt_bas_set_battery_level(battery_level);
}

void hrs_notify(void)
{
	static uint8_t heartrate = 90U;

	/* Heartrate measurements simulation */
	heartrate++;
	if (heartrate == 160U) {
		heartrate = 90U;
	}

	bt_hrs_notify(heartrate);
}
```

## src/hr.c
```c
#include "../inc/hr.h"

uint8_t HR_ADDR = 0x55;

void init_hr() {
    int ret;
    uint8_t data_buffer[2]; // Assuming 2 bytes data from the sensor; adjust as needed
    // Configure pins 11 and 12 as outputs for use with heart rate monitor
	// P0.11 = MFIO and P0.12 = RST
    gpio_pin_configure(gpio0_dev, MFIO, GPIO_OUTPUT_ACTIVE);
	gpio_pin_set(gpio0_dev, MFIO, 0);
    gpio_pin_configure(gpio0_dev, RST, GPIO_OUTPUT_ACTIVE); 
	gpio_pin_set(gpio0_dev, RST, 0);
    
	gpio_pin_set(gpio0_dev, MFIO, 1);
	gpio_pin_set(gpio0_dev, RST, 0);
	k_msleep(250);

	gpio_pin_set(gpio0_dev, MFIO, 0);
	k_msleep(5);
	gpio_pin_set(gpio0_dev, RST, 1);
	k_msleep(5);
	gpio_pin_set(gpio0_dev, MFIO, 1);
	k_msleep(750);

	uint8_t read_mode[2] = {0x02, 0x00};
	ret = i2c_write(i2c0_dev, read_mode, 2, HR_ADDR);
		if (ret < 0) {
			return 0; // Error writing to sensor
		}
	
	uint8_t mode_data[2];
	ret = i2c_read(i2c0_dev, mode_data, sizeof(mode_data), HR_ADDR);
		if (ret < 0) {
			return 0; // Error reading from sensor
		}
	
	printf("Mode:  %u %u\n\n", mode_data[0], mode_data[1]);

	uint8_t read_register_attributes[2] = {0x42, 0x03};
	ret = i2c_write(i2c0_dev, read_register_attributes, 2, HR_ADDR);
		if (ret < 0) {
			return 0; // Error writing to sensor
		}
	
	uint8_t reg_atts[3];
	ret = i2c_read(i2c0_dev, reg_atts, sizeof(reg_atts), HR_ADDR);
		if (ret < 0) {
			return 0; // Error reading from sensor
		}
	
	printf("MAX30101 Register Attributes:  %u %u %u\n\n", reg_atts[0], reg_atts[1], reg_atts[2]);


	uint8_t read_reg_7[3] = {0x41, 0x03, 0x07};
	ret = i2c_write(i2c0_dev, read_reg_7, sizeof(read_reg_7), HR_ADDR);
		if (ret < 0) {
			return 0; // Error writing to sensor
		}
	
	uint8_t reg_7[2];
	ret = i2c_read(i2c0_dev, reg_7, sizeof(reg_7), HR_ADDR);
		if (ret < 0) {
			return 0; // Error reading from sensor
		}
	
	printf("MAX30101 Register 7:  %u %u\n\n", reg_7[0], reg_7[1]);

	uint8_t raw_alg_mode[3] = {0x10, 0x00, 0x03};
	ret = i2c_write(i2c0_dev, raw_alg_mode, sizeof(raw_alg_mode), HR_ADDR);
		if (ret < 0) {
			return 0; // Error writing to sensor
		}
	
	uint8_t raw_alg_response[1];
	ret = i2c_read(i2c0_dev, raw_alg_response, sizeof(raw_alg_response), HR_ADDR);
		if (ret < 0) {
			return 0; // Error reading from sensor
		}
	
	printf("Raw+Alg Data:  %u\n\n", raw_alg_response[0]);
	
	uint8_t set_fifo_limit[3] = {0x10, 0x01, 0x0F};
	ret = i2c_write(i2c0_dev, set_fifo_limit, sizeof(set_fifo_limit), HR_ADDR);
		if (ret < 0) {
			return 0; // Error writing to sensor
		}
	
	uint8_t fifo_limit_response[2];
	ret = i2c_read(i2c0_dev, fifo_limit_response, sizeof(fifo_limit_response), HR_ADDR);
		if (ret < 0) {
			return 0; // Error reading from sensor
		}
	
	k_msleep(1000);
	
	printf("FIFO Threshold:  %u\n\n", fifo_limit_response[0]);
	
	uint8_t en_30101[3] = {0x44, 0x03, 0x01};
	ret = i2c_write(i2c0_dev, en_30101, sizeof(en_30101), HR_ADDR);
		if (ret < 0) {
			return 0; // Error writing to sensor
		}
	
	uint8_t en_30101_response[2];
	ret = i2c_read(i2c0_dev, en_30101_response, sizeof(en_30101_response), HR_ADDR);
		if (ret < 0) {
			return 0; // Error reading from sensor
		}
	
	printf("MAX30101 Enable:  %u\n\n", en_30101_response[0]);

	k_msleep(200);
	
	uint8_t enable_mf[3] = {0x52, 0x02, 0x01};
	ret = i2c_write(i2c0_dev, enable_mf, sizeof(enable_mf), HR_ADDR);
		if (ret < 0) {
			return 0; // Error writing to sensor
		}
	
	uint8_t mf_en_response[2];
	ret = i2c_read(i2c0_dev, mf_en_response, sizeof(mf_en_response), HR_ADDR);
		if (ret < 0) {
			return 0; // Error reading from sensor
		}
	
	printf("MaximFast Enable:  %u\n\n", mf_en_response[0]);
	k_msleep(500);
	uint8_t read_sensor_status[2] = {0x00, 0x00};
	ret = i2c_write(i2c0_dev, read_sensor_status, sizeof(read_sensor_status), HR_ADDR);
		if (ret < 0) {
			return 0; // Error writing to sensor
		}
	BME688_Init();
	uint8_t sensor_status[2];
	ret = i2c_read(i2c0_dev, sensor_status, sizeof(sensor_status), HR_ADDR);
		if (ret < 0) {
			return 0; // Error reading from sensor
		}
	k_msleep(1000);
	printf("Sensor Status:  %u\n\n", sensor_status[0], sensor_status[1]);
}

float read_hr() {
    uint8_t get_fifo[2] = {0x12, 0x01};
    int ret = i2c_write(i2c0_dev, get_fifo, sizeof(get_fifo), HR_ADDR);
    if (ret < 0) {
        return 0; // Error writing to sensor
    }
		
    uint8_t fifo[19];
    ret = i2c_read(i2c0_dev, fifo, sizeof(fifo), HR_ADDR);
    if (ret < 0) {
        return 0; // Error reading from sensor
    }

    float heart_rate = (fifo[13]<<8|fifo[14])/10.0;
    return heart_rate;
}

float read_blood_ox() {
    uint8_t get_fifo[2] = {0x12, 0x01};
    int ret = i2c_write(i2c0_dev, get_fifo, sizeof(get_fifo), HR_ADDR);
    if (ret < 0) {
        return 0; // Error writing to sensor
    }
		
    uint8_t fifo[19];
    ret = i2c_read(i2c0_dev, fifo, sizeof(fifo), HR_ADDR);
    if (ret < 0) {
        return 0; // Error reading from sensor
    }

    float SpO2 = (fifo[16]<<8|fifo[17])/10.0;
    return SpO2;
}
```

## src/imu.c
```c
#include "../inc/imu.h"

const struct device *spi3_dev = DEVICE_DT_GET(SPI3_NODE);
struct spi_config spi3_cfg = {
	.operation = SPI_WORD_SET(8),
	.frequency = 4000000, // 4 MHz, but this depends on your device and board capabilities
	.slave = 0, // Typically, your SPI slave's chip select pin
};
// const struct device *gpio1_dev = DEVICE_DT_GET(MY_GPI01); //cs P107
// struct gpio_callback gpio_cb;

//order: xl_x, xl_y, xl_z, g_x, g_y, g_z
RCFilter lp_filters[NUM_AXES]; 
float cutoff_freqs[NUM_AXES] = {5.0f, 5.0f, 5.0f, 5.0f, 5.0f, 5.0f};

volatile float IMU_readings[NUM_AXES]; //sensor readings in g's and dps
volatile int interrupt_called = 0;
volatile int max_x = 0;

void spi_read_reg(uint8_t reg, uint8_t values[], uint8_t size) {
    int err;

	uint8_t tx_buffer[1];
	tx_buffer[0] = reg;

	struct spi_buf tx_spi_bufs[] = {
		{ .buf = tx_buffer, .len = sizeof(tx_buffer)},	
	};

	struct spi_buf_set spi_tx_buffer_set = {
		.buffers = tx_spi_bufs,
		.count = 1
	};

	struct spi_buf rx_spi_bufs[] = {
		{ .buf = values, .len = size }
	};

	struct spi_buf_set spi_rx_buffer_set = {
		.buffers = rx_spi_bufs,
		.count = 1
	};

	gpio_pin_set(gpio1_dev, GPIO_1_CS, 0);
	do {
		err = spi_write(spi3_dev, &spi3_cfg, &spi_tx_buffer_set);
		if (err < 0) break;

		err = spi_read(spi3_dev, &spi3_cfg, &spi_rx_buffer_set);
	} while (false);

	gpio_pin_set(gpio1_dev, GPIO_1_CS, 1);

	if (err < 0) printk("Read Registers failed: &d\n", err);
}

void spi_write_reg(uint8_t reg, uint8_t data, uint8_t size) {
    int err;

	uint8_t tx_address_buffer[1];
	tx_address_buffer[0] = reg;

	struct spi_buf tx_spi_address_bufs[] = {
		{ .buf = tx_address_buffer, .len = sizeof(tx_address_buffer)},	
	};

	struct spi_buf_set spi_tx_address_buffer_set = {
		.buffers = tx_spi_address_bufs,
		.count = 1
	};

	uint8_t tx_data_buffer[1];
	tx_data_buffer[0] = data;

	struct spi_buf tx_spi_data_bufs[] = {
		{ .buf = tx_data_buffer, .len = sizeof(tx_data_buffer)},	
	};

	struct spi_buf_set spi_tx_data_buffer_set = {
		.buffers = tx_spi_data_bufs,
		.count = 1
	};

	gpio_pin_set(gpio1_dev, GPIO_1_CS, 0);
	do {
		err = spi_write(spi3_dev, &spi3_cfg, &spi_tx_address_buffer_set);
		if (err < 0) break;

		err = spi_write(spi3_dev, &spi3_cfg, &spi_tx_data_buffer_set);
	} while (false);

	gpio_pin_set(gpio1_dev, GPIO_1_CS, 1);

	if (err < 0) printk("Read Registers failed: &d\n", err);
}

void init_IMU() {
	uint8_t reg[1] = {0};
    //output data rate config for gyroscope (952 HZ)
	spi_write_reg(CTRL_REG1_G_WRITE, 0, 1);
	spi_write_reg(CTRL_REG1_G_WRITE, CTRL_REG1_G_952_ODR, 1);
	spi_read_reg(CTRL_REG1_G_READ, reg, 1);
	printk("CTRL_REG1_G reg: %d\n", reg[0]);

    //linear accelerometer sensitivity config (set to +/- 2g), ODR = 952HZ
	spi_write_reg(CTRL_REG6_XL_WRITE, 0, 1);
	spi_write_reg(CTRL_REG6_XL_WRITE, CTRL_REG6_XL_ODR_XL_952, 1);
	spi_read_reg(CTRL_REG6_XL_READ, reg, 1);
	printk("CTRL_REG6_XL reg: %d\n", reg[0]);
}

//enables IMU interrupt generation for certain axes, sets thresholds for desired axes (rn x axis low)
void init_IMU_interrupts() {
	/*
	possibly relevant registers:
	INT_GEN_CFG_XL (06h) - need (enables interrupt generation for certain axes)
	INT_GEN_THS_X/Y/Z_XL (07h) - need (threshold)
	INT_GEN_DUR_XL (0Ah) - don't need (adds wait time after interrupt finishes execution)
	INT1/2_CTRL (0Ch) - might need (interrupt generator for accelerometer, gyroscope, etc.)
	STATUS_REG (17h) - might need (interrupt output signal)
	INT_GEN_SRC_XL (26h) - might need (interrupt x/y/z output); source of interrupts 
                        (e.g. register bits corresponding to axis get set when interrupt fires)
	STATUS_REG (27h): source of interrupts but only for any accelerometer interrupt or gyroscope interrupt

	steps:
	1) enable interrupts for acceleration and/or gyroscope in INT1_CTRL (0Ch)
	2) enable interrupt generation in INT_GEN_CFG_XL (06h) (only enabling x axis for now)
	3) set interrupt threshold in INT_GEN_THS_X/Y/Z_XL
	*/

    //INTERRUPT CONFIG FOR IMU USING IMU REGS

	//set INT_IG_XL in INT1_CTRL (enables interrupt generator on INT1 pin)
	uint8_t reg[1] = {0};
	spi_write_reg(INT1_CTRL_WRITE, 0, 1);
	spi_write_reg(INT1_CTRL_WRITE, INT_IG_XL, 1);
	spi_read_reg(INT1_CTRL_READ, reg, 1);
	printk("INT1_CTRL: %d\n", reg[0]);

	//set XLIE_XL IN INT_GEN_CFG_XL (enables interrupt generation on accelerometer x axis low)
	spi_write_reg(INT_GEN_CFG_XL_WRITE, 0, 1);
	spi_write_reg(INT_GEN_CFG_XL_WRITE, XLIE_XL, 1);
	spi_read_reg(INT_GEN_CFG_XL_READ, reg, 1);
	printk("INT_GEN_CFG_XL: %d\n", reg[0]);

	//set THS_XL_X in INT_GEN_THS_X_XL (sets threshold for x axis of accelerometer)
	spi_write_reg(INT_GEN_THS_X_XL_WRITE, 0, 1);
	spi_write_reg(INT_GEN_THS_X_XL_WRITE, 0b00000001, 1);
	spi_read_reg(INT_GEN_THS_X_XL_READ, reg, 1);
	printk("INT_GEN_THS_X_XL: %d\n", reg[0]);


    //INTERRUPT CONFIG FOR BOARD

    //configure gpio pin connected to interrupt pin (INT1)
	static const struct device *gpio1 = DEVICE_DT_GET(DT_NODELABEL(gpio1));
	if (!gpio1) {
        printk("Cannot find!\n");
        return 0;
    }
	int ret = gpio_pin_configure(gpio1, PIN_1_02, GPIO_INPUT | GPIO_PULL_DOWN);
	if (ret != 0) {
        printk("Error %d: Could not configure GPIO pin\n", ret);
        return;
	}

	// gpio_init_callback(&gpio_cb, IMU_interrupt_cb, BIT(PIN_1_02));
	// gpio_add_callback(gpio1, &gpio_cb); //code crashes here. TODO: fix this
	ret = gpio_pin_interrupt_configure(gpio1, PIN_1_02, GPIO_INT_EDGE_RISING | GPIO_INT_EDGE_TO_ACTIVE);
	printk("return value of interrupt configure: %d\n", ret);
	
	int value = gpio_pin_get (gpio1, PIN_1_02);
	printk("initial PIN_1_02 value: %d\n", value);
}

//interrupt handler function
void IMU_interrupt_cb(const struct device *dev, struct gpio_callback *cb, uint32_t pins) {
	ARG_UNUSED(dev);
    ARG_UNUSED(cb);
    ARG_UNUSED(pins);

    interrupt_called = 1;
}

void init_IMU_cs() {
    gpio_pin_configure(gpio1_dev, GPIO_1_CS, GPIO_OUTPUT | GPIO_OUTPUT_INIT_HIGH);
}

int i = 1;
void poll_IMU() {
    if (interrupt_called) {
			print_unfiltered_readings();
			printk("max xl_x: %d\n", max_x);
			printk("interrupt fired\n");
			interrupt_called = 0;
	}

	//Accelerometer
	int8_t rx_buf_xl_x_lower[1];
	int8_t rx_buf_xl_x_upper[1];
	spi_read_reg(ACCEL_X_LOWER, rx_buf_xl_x_lower, 1);
	spi_read_reg(ACCEL_X_UPPER, rx_buf_xl_x_upper, 1);

	int8_t rx_buf_xl_y_lower[1];
	int8_t rx_buf_xl_y_upper[1];
	spi_read_reg(ACCEL_Y_LOWER, rx_buf_xl_y_lower, 1);
	spi_read_reg(ACCEL_Y_UPPER, rx_buf_xl_y_upper, 1);

	int8_t rx_buf_xl_z_lower[1];
	int8_t rx_buf_xl_z_upper[1];
	spi_read_reg(ACCEL_Z_LOWER, rx_buf_xl_z_lower, 1);
	spi_read_reg(ACCEL_Z_UPPER, rx_buf_xl_z_upper, 1);
	
	IMU_readings[XL_X_IND] = ((rx_buf_xl_x_upper[0] << 8 | rx_buf_xl_x_lower[0]) * 0.061) / 1000;
	IMU_readings[XL_Y_IND] = ((rx_buf_xl_y_upper[0] << 8 | rx_buf_xl_y_lower[0]) * 0.061) / 1000;
	IMU_readings[XL_Z_IND] = ((rx_buf_xl_z_upper[0] << 8 | rx_buf_xl_z_lower[0]) * 0.061) / 1000;
	// xl_x = ((rx_buf_xl_x_upper[0] << 8 | rx_buf_xl_x_lower[0]) * 0.061) / 1000;
	// xl_y = ((rx_buf_xl_y_upper[0] << 8 | rx_buf_xl_y_lower[0]) * 0.061) / 1000;
	// xl_z = ((rx_buf_xl_z_upper[0] << 8 | rx_buf_xl_z_lower[0]) * 0.061) / 1000;

	//Gyroscope
	int8_t rx_buf_g_x_lower[1];
	int8_t rx_buf_g_x_upper[1];
	spi_read_reg(G_X_LOWER, rx_buf_g_x_lower, 1);
	spi_read_reg(G_X_UPPER, rx_buf_g_x_upper, 1);

	int8_t rx_buf_g_y_lower[1];
	int8_t rx_buf_g_y_upper[1];
	spi_read_reg(G_Y_LOWER, rx_buf_g_y_lower, 1);
	spi_read_reg(G_Y_UPPER, rx_buf_g_y_upper, 1);

	int8_t rx_buf_g_z_lower[1];
	int8_t rx_buf_g_z_upper[1];
	spi_read_reg(G_Z_LOWER, rx_buf_g_z_lower, 1);
	spi_read_reg(G_Z_UPPER, rx_buf_g_z_upper, 1);

	//method on how to convert raw gyroscope values to dps: https://forum.arduino.cc/t/gyro-raw-to-deg-s-conversion-code-snippet-needed/179022/3
	IMU_readings[G_X_IND] = ((rx_buf_g_x_upper[0] << 8 | rx_buf_g_x_lower[0]) - 2.226) * (8.75 / 1000);
	IMU_readings[G_Y_IND] = ((rx_buf_g_y_upper[0] << 8 | rx_buf_g_y_lower[0]) - 40.722) * (8.75 / 1000);
	IMU_readings[G_Z_IND] = ((rx_buf_g_z_upper[0] << 8 | rx_buf_g_z_lower[0]) - (-209.072)) * (8.75 / 1000);

	// print_unfiltered_readings();
	print_filtered_readings();
}

//helper function to be called in main
void init_RCFilters() {
	for (int i = 0; i < NUM_AXES; i++) {
		RCFilter_Init(&lp_filters[i], cutoff_freqs[i], 0.00105042016f);
	}
}

void print_unfiltered_readings() {
	char unfiltered_buf[NUM_AXES][10];

	snprintf(unfiltered_buf[XL_X_IND], sizeof(unfiltered_buf[XL_X_IND]), "%f", (float)IMU_readings[XL_X_IND]);
	snprintf(unfiltered_buf[XL_Y_IND], sizeof(unfiltered_buf[XL_Y_IND]), "%f", (float)IMU_readings[XL_Y_IND]);
	snprintf(unfiltered_buf[XL_Z_IND], sizeof(unfiltered_buf[XL_Z_IND]), "%f", (float)IMU_readings[XL_Z_IND]);
	snprintf(unfiltered_buf[G_X_IND], sizeof(unfiltered_buf[G_X_IND]), "%f", (float)IMU_readings[G_X_IND]);
	snprintf(unfiltered_buf[G_Y_IND], sizeof(unfiltered_buf[G_Y_IND]), "%f", (float)IMU_readings[G_Y_IND]);
	snprintf(unfiltered_buf[G_Z_IND], sizeof(unfiltered_buf[G_Z_IND]), "%f", (float)IMU_readings[G_Z_IND]);

	printf("xl_x: %s     xl_y: %s     xl_z: %s     g_x: %s     g_y: %s     g_z: %s\n", 
			unfiltered_buf[XL_X_IND], unfiltered_buf[XL_Y_IND], unfiltered_buf[XL_Z_IND],
			unfiltered_buf[G_X_IND], unfiltered_buf[G_Y_IND], unfiltered_buf[G_Z_IND]);
}

void print_filtered_readings() {
	char filtered_buf[NUM_AXES][10];

	for (int i = 0; i < NUM_AXES; i++) {
		//order: xl_x, xl_y, xl_z, g_x, g_y, g_z
		float filtered_reading = RCFilter_Update(&lp_filters[i], IMU_readings[i]);
		snprintf(filtered_buf[i], sizeof(filtered_buf[i]), "%f", filtered_reading);
	}

	//FILTERED VALUES
	printf("xl_x: %s     xl_y: %s     xl_z: %s     g_x: %s     g_y: %s     g_z: %s\n", 
			filtered_buf[XL_X_IND], filtered_buf[XL_Y_IND], filtered_buf[XL_Z_IND],
			filtered_buf[G_X_IND], filtered_buf[G_Y_IND], filtered_buf[G_Z_IND]);
}

void print_readings_csv() {

}
```
